 /*
    Based on Neil Kolban example for IDF: https://github.com/nkolban/esp32-snippets/blob/master/cpp_utils/tests/BLE%20Tests/SampleServer.cpp
    Ported to Arduino ESP32 by Evandro Copercini
    updates by chegewara
*/

#include <BLEDevice.h>
//#include <BLEUtils.h>
#include <BLEServer.h>
#include <BLE2902.h>
#include <string>

#define TRANSMISSION_SIZE 500

// See the following for generating UUIDs:
// https://www.uuidgenerator.net/
#define  TEST_SERVICE_UUID  "f9fd0005-71ae-42c4-bd19-9d5e37ebf073"
#define  TEST_CHAR_1        "f9fd0006-71ae-42c4-bd19-9d5e37ebf073"
#define  TEST_CHAR_2        "f9fd0016-71ae-42c4-bd19-9d5e37ebf073"
#define  TEST_CHAR_3        "f9fd0017-71ae-42c4-bd19-9d5e37ebf073"

String payloadName = "MVPayload_Nest";

///// PICTURE BIT MAP //////////////
size_t iLen = 10800;
const int iLen_int = 10800 ;
uint8_t image[iLen_int] = {249,249,249,249,249,241,249,241,249,232,157,70,52,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249,};                        
        
uint8_t *image_p = image; //Sets pointer to first element in array
int currentLocation = 0;
int largeDataSize = 0;

int latPin = 4;
///////////////////////////////////

BLEServer *pServer = NULL;
BLECharacteristic * pTestChar_1;

bool deviceConnected = false;

class MyServerCallbacks: public BLEServerCallbacks {
  // TODO this doesn't take into account several clients being connected
    
    void onConnect(BLEServer* pServer) {
      BLEAdvertising *pAdvertising = BLEDevice::getAdvertising();
      pAdvertising->start();
      deviceConnected = true;
      Serial.println("I connected!");
    };
    
    void onDisconnect(BLEServer* pServer) {
      Serial.println("I Disconnected!");
      deviceConnected = false;
    }  
};


class MyCallbacks: public BLECharacteristicCallbacks {
    void onWrite(BLECharacteristic *pCharacteristic) {
      std::string uuid = pCharacteristic->getUUID().toString();
      std::string value = pCharacteristic->getValue();

      if (value.length() > 0) {
        Serial.println("*********");
        Serial.print("From UUID: ");
        Serial.println(uuid.c_str());
        for (int i = 0; i < value.length(); i++)
          Serial.print(value[i]);

        Serial.println();
        Serial.println("*********");
      }
    }

    void onRead(BLECharacteristic* pCharacteristic) {
      String uuid = pCharacteristic->getUUID().toString().c_str();
      Serial.print("Someone wants to read my data: ");
      Serial.println(uuid.c_str());
      BLEUUID hit = pCharacteristic->getUUID();
      BLEUUID BLETST = BLEUUID(TEST_CHAR_2);
      //Serial.println("Someone wants to read my data: ");

      if(hit.equals(BLETST))
      {
         String randNumber = String(random(300));
         String message = randNumber;
         Serial.print("Transmitting: ");
         Serial.println(message.c_str());
         pCharacteristic->setValue(message.c_str());
      }
      else
      {
        Serial.println("Unknown UUID!");  
      }
   }
};

void setup()
{
  Serial.begin(115200);                                                         // Initialize serial port
  Serial.println("Starting BLE work!");

  pinMode(latPin, OUTPUT);

  BLEDevice::init(payloadName.c_str());                                                      // Initialize the BLE device
  BLEDevice::setPower(ESP_PWR_LVL_N14);
  BLEServer *pServer = BLEDevice::createServer();                               // Save the BLE device server

  //Creating Services
  BLEService *pTestService = pServer->createService(TEST_SERVICE_UUID);                 // Create the service UUID from the server
  //BLEService *pBestService = pServer->createService(BEST_SERVICE_UUID);                 // Create the service UUID from the server
    
  //Creating Characteristics
  pTestChar_1 = pTestService->createCharacteristic(                                // Create the characteristic UUID for server
                                         BLEUUID(TEST_CHAR_3),
                                         BLECharacteristic::PROPERTY_READ  |
                                         BLECharacteristic::PROPERTY_WRITE |
                                         BLECharacteristic::PROPERTY_NOTIFY |
                                         BLECharacteristic::PROPERTY_INDICATE
                                       );

  /*pBestChar_1 = pBestService->createCharacteristic(                                // Create the characteristic UUID for server
                                         BEST_CHAR_1,
                                         BLECharacteristic::PROPERTY_READ  |
                                         BLECharacteristic::PROPERTY_WRITE |
                                         BLECharacteristic::PROPERTY_NOTIFY |
                                         BLECharacteristic::PROPERTY_INDICATE
                                       );
  */
  pTestChar_1->setCallbacks(new MyCallbacks()); 

  pTestChar_1->addDescriptor(new BLE2902());

  //pBestChar_1->setCallbacks(new MyCallbacks()); 

  //pBestChar_1->addDescriptor(new BLE2902());

  pTestService->start();                                                            // Start service

  //pBestService->start();   
  
  pServer->setCallbacks(new MyServerCallbacks());                               // Set server callbacks
  
  //Advertising
  BLEAdvertising *pAdvertising = BLEDevice::getAdvertising();                   // Grab advertisiing service
  pAdvertising->addServiceUUID(TEST_SERVICE_UUID);   
  // pAdvertising->addServiceUUID(BEST_SERVICE_UUID);  
  pAdvertising->setScanResponse(true);                                          
  pAdvertising->setMinPreferred(0x06);  // functions that help with iPhone connections issue
  pAdvertising->setMinPreferred(0x12);
  BLEDevice::startAdvertising();                                                // Start advertising
  Serial.println("Setup Complete. We are Advertising!");
}

void sendNotify(BLECharacteristic* chr, int notif = 0)
{
  if(notif != 0);
  {
    Serial.println("Setting Notify Value!");
    chr->setValue((uint32_t&)notif); 
  }
  chr->notify();
  Serial.println("Notification Sent");
} 

int isNotZero(int num)
{
  if(num == 0)
  {
    return 0;
  }
  return 1;
}

void sendLargeData(BLECharacteristic* chr, uint8_t *image_p, int len)
{
  Serial.println("Configuring Large Data");
  currentLocation = 0;
  largeDataSize = len;
  int totalTranmissions = (len/TRANSMISSION_SIZE) + isNotZero(len%TRANSMISSION_SIZE);
  Serial.print("Total Transmissions: ");
  Serial.println(totalTranmissions);
  sendNotify(chr, totalTranmissions);
}


void loop() {
  if (deviceConnected) {
     Serial.println("Wow, I am connected!");
     Serial.println("Sending Notification!");
     sendNotify(pTestChar_1);
  }
  else
  {
     Serial.print(BLEDevice::getAddress().toString().c_str());
     Serial.println(" Device is not Connected");
  }
  int randNumber = random(4,10);
  delay(randNumber*1000);
  delay((10-randNumber + 10)*1000);
}
